// import the default shield configuration
#include "corne.dtsi"


/delete-node/ &kscan0;


/ {
    chosen {
        zmk,kscan = &mock_kscan;
    };
    mock_kscan: kscan_1 {
        compatible = "zmk,kscan-mock";
        
        columns = <0>;
        rows = <0>;
        events = <0>;
    };
};
